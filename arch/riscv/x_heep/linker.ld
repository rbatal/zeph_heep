/*
  * X-HEEP SoC linker script for Zephyr RTOS.
  * Modded version of include/zephyr/arch/riscv/common/linker.ld.
  *
  * The following modifications were performed:
  *
  *   The 'reset' section is forced to 0x180 (the X-HEEP core reset vector
  *   is hardwired in that address.  The ELF entry point (e_entry) has also
  *   to be set at 0x180 so GDB lands in the proper PC at startup.
  *
  *   CAUTION:
  *   soc/x_heep/reset.S must use '.section .reset, "ax"' instead of
  *   '.section .text' in order to force the primitive __reset to place
  *   the 'reset' section at 0x180.
*/

#include <zephyr/devicetree.h>

#include <zephyr/linker/sections.h>
#include <zephyr/linker/devicetree_regions.h>

#include <zephyr/linker/linker-defs.h>
#include <zephyr/linker/linker-tool.h>

//* X-HEEP CV32E40P hardware boot address (reset vector)
#define XHEEP_BOOT_ADDRESS 0x180

//* X-HEEP has no XIP flash execution -> code always runs from SRAM.
//* Removed everything related as precaution
#define ROMABLE_REGION              RAM

#define RAMABLE_REGION              RAM

#define _EXCEPTION_SECTION_NAME     exceptions
#define _RESET_SECTION_NAME         reset

//* Non-XIP: ROM and RAM both map to the SRAM bank.
#if defined(CONFIG_ROM_END_OFFSET)
#define ROM_END_OFFSET CONFIG_ROM_END_OFFSET
#else
#define ROM_END_OFFSET 0
#endif

#define ROM_BASE CONFIG_SRAM_BASE_ADDRESS
#define ROM_SIZE (KB(CONFIG_SRAM_SIZE) - ROM_END_OFFSET)
#define RAM_BASE CONFIG_SRAM_BASE_ADDRESS
#define RAM_SIZE KB(CONFIG_SRAM_SIZE)

#ifdef CONFIG_RISCV_PMP
	#define MPU_MIN_SIZE CONFIG_PMP_GRANULARITY
	#define MPU_MIN_SIZE_ALIGN . = ALIGN(MPU_MIN_SIZE);
	#if defined(CONFIG_MPU_REQUIRES_POWER_OF_TWO_ALIGNMENT)
		#define MPU_ALIGN(region_size) \
			. = ALIGN(MPU_MIN_SIZE); \
			. = ALIGN( 1 << LOG2CEIL(region_size))
	#else
		#define MPU_ALIGN(region_size) \
			. = ALIGN(MPU_MIN_SIZE)
	#endif
#else
	#define MPU_MIN_SIZE_ALIGN
	#define MPU_ALIGN(region_size) . = ALIGN(4)
#endif

#include <zephyr/linker/linker-devnull.h>

MEMORY
{
	RAM (rwx) : ORIGIN = RAM_BASE, LENGTH = RAM_SIZE

#if defined(CONFIG_LINKER_DEVNULL_MEMORY)
	DEVNULL_ROM (rx) : ORIGIN = DEVNULL_ADDR, LENGTH = DEVNULL_SIZE
#endif

	LINKER_DT_REGIONS()

	/* Used by and documented in include/linker/intlist.ld */
	IDT_LIST  (wx)      : ORIGIN = 0xFFFFF000, LENGTH = 4K
}

/*
 * Entry point: __reset at 0x180.
 * This sets e_entry in the .elf header, which GDB/OpenOCD use as the
 * initial PC. The X-HEEP hardware independently resets to 0x180
 * regardless of this field (hardcoded into the design).
*/
ENTRY(__reset)

SECTIONS
{

#include <zephyr/linker/rel-sections.ld>

	SECTION_PROLOGUE(.plt,,)
  {
    *(.plt)
  }

	SECTION_PROLOGUE(.iplt,,)
  {
    *(.iplt)
  }

	GROUP_START(ROMABLE_REGION)
	__rom_region_start = ROM_BASE;

	/*
	 * rom_start (0x0): Zephyr RISC-V vector table stub generated by
	 * arch/riscv/core/vector_table.ld
	 * On X-HEEP this code is never executed — the hardware starts at
	 * 0x180. keeping it avoids __start undefined-symbol errors
	 * from the Zephyr arch code that emits to .vectors.*.
	*/
	SECTION_PROLOGUE(rom_start,,)
	{
		. = ALIGN(16);
/* Located in generated directory. This file is populated by calling
 * zephyr_linker_sources(ROM_START ...).
 */
#include <snippets-rom-start.ld>
	} GROUP_LINK_IN(ROMABLE_REGION)

	/*
	 * Force __reset to the X-HEEP hardware boot address.
	 * The VMA is set explicitly in the section definition (GNU ld
	 * ignores a standalone '. = addr' before sections that use
	 * '> region').
   * The gap from end-of-rom_start (~0x10) to 0x180 is zero-padded
   * in the ELF LOAD segment.
	 *
	 * CAUTION:
   * reset.S must use '.section .reset, "ax"' so that
	 * __reset is captured here rather than falling into 'text'.
	*/
	SECTION_PROLOGUE(_RESET_SECTION_NAME, XHEEP_BOOT_ADDRESS,)
	{
		KEEP(*(.reset .reset.*))
	} GROUP_LINK_IN(ROMABLE_REGION)

	/*
	 * Direct-mode trap handler (_isr_wrapper / _exception.entry.*).
	 * mtvec is set to &_isr_wrapper by __reset at runtime, so the
	 * address here is discovered dynamically, no hardcoded 0x100.
	*/
	SECTION_PROLOGUE(_EXCEPTION_SECTION_NAME,,)
	{
		KEEP(*(".exception.entry.*"))
		*(".exception.other.*")
	} GROUP_LINK_IN(ROMABLE_REGION)

#ifdef CONFIG_CODE_DATA_RELOCATION
#include <linker_relocate.ld>
#endif

	SECTION_PROLOGUE(_TEXT_SECTION_NAME,,)
	{
		. = ALIGN(4);
		KEEP(*(.openocd_debug))
		KEEP(*(".openocd_debug.*"))

		__text_region_start = .;

		*(.text)
		*(".text.*")
		*(.gnu.linkonce.t.*)
#include <zephyr/linker/kobject-text.ld>
	} GROUP_LINK_IN(ROMABLE_REGION)

	__text_region_end = .;

	__rodata_region_start = .;
#include <zephyr/linker/common-rom.ld>
/* Located in generated directory. This file is populated by calling
 * zephyr_linker_sources(ROM_SECTIONS ...). Useful for grouping iterable RO structs.
 */
#include <snippets-rom-sections.ld>
#include <zephyr/linker/thread-local-storage.ld>

	SECTION_PROLOGUE(_RODATA_SECTION_NAME,,)
	{
		. = ALIGN(4);
		*(.srodata)
		*(".srodata.*")
		*(.rodata)
		*(".rodata.*")
		*(.gnu.linkonce.r.*)
		*(.sdata2 .sdata2.* .gnu.linkonce.s2.*)

/* Located in generated directory. This file is populated by the
 * zephyr_linker_sources() Cmake function.
 */
#include <snippets-rodata.ld>
#include <zephyr/linker/kobject-rom.ld>
		. = ALIGN(4);
	} GROUP_LINK_IN(ROMABLE_REGION)

#include <zephyr/linker/cplusplus-rom.ld>
	__rodata_region_end = .;

	//* Non-XIP: rom_region ends where rodata ends (no separate flash).
	__rom_region_end = .;
	__rom_region_size = __rom_region_end - __rom_region_start;

	GROUP_END(ROMABLE_REGION)

	GROUP_START(RAMABLE_REGION)

	. = RAM_BASE;
	_image_ram_start = .;
/* Located in generated directory. This file is populated by the
 * zephyr_linker_sources() Cmake function.
 */
#include <snippets-ram-sections.ld>

	SECTION_DATA_PROLOGUE(_DATA_SECTION_NAME,,)
	{
		 . = ALIGN(4);
		/* _image_ram_start = .; */
		__kernel_ram_start = .;
		__data_region_start = .;
		__data_start = .;

		*(.data)
		*(".data.*")

#ifdef CONFIG_RISCV_GP
		/*
		 * RISC-V architecture has 12-bit signed immediate offsets in the
		 * instructions. If we can put the most commonly accessed globals
		 * in a special 4K span of memory addressed by the GP register, then
		 * we can access those values in a single instruction, saving both
		 * codespace and runtime.
		 *
		 * Since these immediate offsets are signed, place gp 0x800 past the
		 * beginning of .sdata so that we can use both positive and negative
		 * offsets.
		 */
		. = ALIGN(8);
		PROVIDE (__global_pointer$ = . + 0x800);
#endif

		*(.sdata .sdata.* .gnu.linkonce.s.*)

/* Located in generated directory. This file is populated by the
 * zephyr_linker_sources() Cmake function.
 */
#include <snippets-rwdata.ld>

#ifdef CONFIG_CODE_DATA_RELOCATION
#include <linker_sram_data_relocate.ld>
#endif

		__data_end = .;

	}  GROUP_DATA_LINK_IN(RAMABLE_REGION, ROMABLE_REGION)
	__data_size = __data_end - __data_start;
	__data_load_start = LOADADDR(_DATA_SECTION_NAME);
  
	__data_region_load_start = LOADADDR(_DATA_SECTION_NAME);

#include <zephyr/linker/common-ram.ld>
#include <zephyr/linker/kobject-data.ld>
#include <zephyr/linker/cplusplus-ram.ld>

/* Located in generated directory. This file is populated by the
 * zephyr_linker_sources() Cmake function.
 */
#include <snippets-data-sections.ld>

	__data_region_end = .;

	SECTION_DATA_PROLOGUE(_BSS_SECTION_NAME,(NOLOAD),)
	{
		MPU_MIN_SIZE_ALIGN
		/*
		 * For performance, BSS section is assumed to be 4 byte aligned and
     * a multiple of 4 bytes
		 */
		. = ALIGN(4);
		__bss_start = .;
		*(.sbss)
		*(".sbss.*")
		*(.bss)
		*(".bss.*")
		COMMON_SYMBOLS

#ifdef CONFIG_CODE_DATA_RELOCATION
#include <linker_sram_bss_relocate.ld>
#endif

		 /*
		  * As memory is cleared in words only, it is simpler to ensure the BSS
		  * section ends on a 4 byte boundary. This wastes a maximum of 3 bytes.
		  */
		__bss_end = ALIGN(4);
	}  GROUP_DATA_LINK_IN(RAMABLE_REGION, RAMABLE_REGION)

#include <zephyr/linker/common-noinit.ld>

	__kernel_ram_end = .;
	__kernel_ram_size = __kernel_ram_end - __kernel_ram_start;

/* Located in generated directory. This file is populated by the
 * zephyr_linker_sources() Cmake function.
 */
#include <snippets-sections.ld>

#define LAST_RAM_ALIGN MPU_MIN_SIZE_ALIGN

#include <zephyr/linker/ram-end.ld>

	GROUP_END(RAMABLE_REGION)

#include <zephyr/linker/debug-sections.ld>

	/DISCARD/ : { *(.note.GNU-stack) }

	SECTION_PROLOGUE(.riscv.attributes, 0,)
	{
		KEEP(*(.riscv.attributes))
		KEEP(*(.gnu.attributes))
	}

	/* Sections generated from 'zephyr,memory-region' nodes */
	LINKER_DT_SECTIONS()
}
