## Kconfig
```kconfig
# SPDX-License-Identifier: Apache-2.0
# X-HEEP Zephyr Module Root Kconfig

# This file is required by module.yml
# It sources the SoC Kconfig hierarchy

rsource "soc/x_heep/Kconfig"
rsource "drivers/Kconfig"
```

## boards/esl_epfl/x_heep/Kconfig.x_heep
```kconfig
#
# X-HEEP Board Kconfig
#

config BOARD_X_HEEP
	select SOC_X_HEEP

config XHEEP_FPGA_PYNQZ2
	bool "PYNQ-Z2 FPGA target (15 MHz system clock)"
	default n
	help
    Build configured for the PYNQ-Z2 FPGA implementation.
	  System clock set to 15MHz at devicetree level.
    UART baudrate set to 115200 at devicetree level.
```

## boards/esl_epfl/x_heep/board.yml
```yaml
# 
# X-HEEP Board Definition
#

board:
  name: x_heep
  full_name: X-HEEP "Chip"
  vendor: esl_epfl
  socs:
    - name: x_heep
```

## boards/esl_epfl/x_heep/x_heep_defconfig
```kconfig
# 
# X-HEEP Board Configuration
#

# ============================================================
# Optimization (prevents ISR table alignment issues)
# ============================================================
CONFIG_SIZE_OPTIMIZATIONS=y

# ============================================================
# Memory Configuration
# ============================================================
CONFIG_XIP=n

# Stack sizes
CONFIG_MAIN_STACK_SIZE=2048
CONFIG_ISR_STACK_SIZE=2048
CONFIG_IDLE_STACK_SIZE=512

# ============================================================
# Interrupt Configuration
# ============================================================
CONFIG_GEN_ISR_TABLES=y
CONFIG_GEN_IRQ_VECTOR_TABLE=n
CONFIG_GEN_SW_ISR_TABLE=y

# Suppress the SiFive PLIC driver (incompatible register layout).
# X-HEEP uses a custim driver (esl-epfl,x-heep-plic).
# CONFIG_MULTI_LEVEL_INTERRUPTS and CONFIG_2ND_LEVEL_INTERRUPTS are
# automatically selected by CONFIG_X_HEEP_PLIC via its local Kconfig.
CONFIG_PLIC=n
CONFIG_X_HEEP_PLIC=y

# ============================================================
# Timer Configuration
# ============================================================
CONFIG_RISCV_MACHINE_TIMER=y
CONFIG_SYS_CLOCK_HW_CYCLES_PER_SEC=100000000

# ============================================================
# Console/UART Configuration
# ============================================================
CONFIG_CONSOLE=y
CONFIG_UART_CONSOLE=y
CONFIG_SERIAL=y

# Explicitly enable X-HEEP UART driver (OpenTitan-derived, not the one in Zephyr libs)
CONFIG_UART_X_HEEP=y

# Use polling mode (no interrupts available yet until PLIC ready)
CONFIG_UART_INTERRUPT_DRIVEN=n

# Enable printk output
CONFIG_PRINTK=y
CONFIG_EARLY_CONSOLE=y

# Enable stdout -> console redirection for printf()
CONFIG_STDOUT_CONSOLE=y
```

## drivers/Kconfig
```kconfig
#
# Drivers folder Kconfig
#

# Serial Comms child Kconfig
rsource "serial/Kconfig"

# Interrupt Controller child Kconfig
rsource "interrupt_controller/Kconfig"

# Counter child Kconfig
rsource "timer/Kconfig"

# GPIO child Kconfig
rsource "gpio/Kconfig"
```

## drivers/gpio/Kconfig
```kconfig
#
# GPIO driver Kconfig
#

config XHEEP_GPIO
  bool "X-HEEP GPIO Controller (PULP Platform GPIO)"
  default y
  depends on DT_HAS_ESL_EPFL_X_HEEP_GPIO_ENABLED || \
             DT_HAS_ESL_EPFL_X_HEEP_GPIO_AO_ENABLED
  select GPIO
  help
    Custom GPIO driver for the X-HEEP platform.
    This one peripheral is directly from the PULP repo.
    Supports two hardware instances:
      esl-epfl,x-heep-gpio-ao
        Always-On GPIO (8 pins). Interrupt lines tied to FIC (6-13).
      esl-epfl,x-heep-gpio
        User-domain GPIO (24 pins). Interrupt lines tied to PLIC (9-32).
```

## drivers/interrupt_controller/Kconfig
```kconfig
#
# Interrupt Controller Kconfig
#

config XHEEP_PLIC
  bool "X-HEEP Platform-Level Interrupt Controller"
  default y
  depends on RISCV_HAS_PLIC
  depends on !PLIC
  select MULTI_LEVEL_INTERRUPTS
  select 2ND_LEVEL_INTERRUPTS
  help
    Custom PLIC driver for the X-HEEP platform.
    The lowRISC/OpenTitan rv_plic in X-HEEP uses a compact
    register layout that is NOT compatible with the standard
    RISC-V PLIC memory map expected by Zephyr's built-in
    intc_plic.c driver.

    This driver provides the riscv_plic_* API using the correct
    compact register offsets.

config XHEEP_FIC
  bool "X-HEEP Fast Interrupt Controller"
  default y
  depends on DT_HAS_ESL_EPFL_X_HEEP_FIC_ENABLED
  help
    Custom FIC driver for the X-HEEP platform.
    Routes 16 interrupt sources to the core's fast IRQ lines irq_i[31:16]
    (mcause 16-31), bypassing the PLIC.
```

## drivers/serial/Kconfig
```kconfig
#
# Serial Comms Kconfig
#

config UART_X_HEEP
	bool "X-HEEP UART"
	default y
	depends on DT_HAS_ESL_EPFL_X_HEEP_UART_ENABLED
	select SERIAL_HAS_DRIVER
	help
	  Enable X-HEEP UART driver (official OpenTitan, differs from Zephyr libs).
```

## drivers/timer/Kconfig
```kconfig
#
# Timer Kconfig
#

config XHEEP_RV_TIMER
  bool "X-HEEP Timer(s)"
  default y
  depends on DT_HAS_ESL_EPFL_X_HEEP_RV_TIMER_ENABLED
  select COUNTER
  help
    Enable the driver for the lowRISC rv_timer IP in the X-HEEP
    user peripheral domain. Provides the Zephyr counter API (start, stop,
    get_value, get_freq, set_channel_alarm, cancel_channel_alarm).
```

## dts/bindings/gpio/esl-epfl,x-heep-gpio-ao.yaml
```yaml
# author: rbatal (rodrigo.batal@gmail.com)

description: >
  X-HEEP GPIO_AO Controller

  8 GPIO pins. Pins are wired to FIC sources 6-13 (mcause 22-29) and support
  edge and level interrupts through the native Zephyr interrupt functions.
  
  Each pin has a dedicated hlic IRQ (mcause = 22+pin).
  Interrupts are declared via interrupts-extended = <&hlic 22>...<&hlic 29>.

compatible: "esl-epfl,x-heep-gpio-ao"

include: [base.yaml, gpio-controller.yaml]
```

## dts/bindings/gpio/esl-epfl,x-heep-gpio.yaml
```yaml
# author: rbatal (rodrigo.batal@gmail.com)

description: >
  X-HEEP GPIO_USER

  24 GPIO pins. Pins are wired to PLIC interrupt sources 9-32
  and support edge and level interrupts via the X-HEEP custom PLIC.
  
  Interrupts are declared via interrupt-parent = <&plic> and
  interrupts = <source priority> (one entry per IRQ-capable pin).

compatible: "esl-epfl,x-heep-gpio"

include: [base.yaml, gpio-controller.yaml]
```

## dts/bindings/interrupt-controller/esl-epfl,x-heep-fic.yaml
```yaml
# author: rbatal (rodrigo.batal@gmail.com)

description: |
  X-HEEP Fast Interrupt Controller (FIC)

  Routes 16 fast interrupt sources directly to irq_i[31:16], (bypassing the
  PLIC).
  Source N maps to mcause (16+N). The driver also controls the corresponding
  MIE CSR bits so the core takes the trap.

  FIC source index table (from fast_intr_ctrl.sv):
    0  kTimer_1_fic_e   — rv_timer channel 1
    1  kTimer_2_fic_e   — rv_timer channel 2
    2  kTimer_3_fic_e   — rv_timer channel 3
    3  kDma_done_fic_e  — DMA transaction done
    4  kSpi_fic_e       — SPI host
    5  kSpiFlash_fic_e  — SPI flash controller
    6  kGpio_0_fic_e    — AO GPIO 0
    7  kGpio_1_fic_e    — AO GPIO 1
    8  kGpio_2_fic_e    — AO GPIO 2
    9  kGpio_3_fic_e    — AO GPIO 3
   10  kGpio_4_fic_e    — AO GPIO 4
   11  kGpio_5_fic_e    — AO GPIO 5
   12  kGpio_6_fic_e    — AO GPIO 6
   13  kGpio_7_fic_e    — AO GPIO 7
   14  kDma_window_fic_e — DMA window done
   15  kExt_peri_fic_e  — external peripheral

  Register map (from base):
    0x000  PENDING  (bit N set when source N is pending)
    0x004  CLEAR    (write 1 in the corresponding bit to acknowledge and clear)
    0x008  ENABLE   (bit N set for source N enable mask)

compatible: "esl-epfl,x-heep-fic"

include: [base.yaml]

properties:
  reg:
    required: true
```

## dts/bindings/interrupt-controller/esl-epfl,x-heep-plic.yaml
```yaml
# author: rbatal (rodrigo.batal@gmail.com)

description: |
  X-HEEP Platform-Level Interrupt Controller (PLIC)

  Based on the lowRISC/OpenTitan rv_plic IP with a compact
  (non-spec-compliant) register layout. 64 sources, 1 target,
  3-bit priority (0-7), level/edge configurable per source.

  Register map (from base):
    0x000-0x004  IP           (pending, 2x32-bit)
    0x008-0x00C  LE           (level/edge mode, 2x32-bit)
    0x010-0x10C  PRIO         (64 source priorities, 3-bit each)
    0x200-0x204  IE0          (enable for target 0, 2x32-bit)
    0x208        THRESHOLD0
    0x20C        CC0          (claim/complete)
    0x210        MSIP0

compatible: "esl-epfl,x-heep-plic"

include: [interrupt-controller.yaml, base.yaml]

properties:
  reg:
    required: true
    description: Base address and size of the PLIC register space.

  "#interrupt-cells":
    required: true
    const: 2
    description: |
      Cell 0: IRQ number (PLIC source ID, 1-63)
      Cell 1: IRQ priority (1-7, 0 = disabled)

  riscv,max-priority:
    type: int
    required: true
    description: Maximum priority value supported (7 for X-HEEP).

  riscv,ndev:
    type: int
    required: true
    description: Number of external interrupt sources (64 for X-HEEP).

  interrupts-extended:
    required: true
    description: |
      Connection to CPU interrupt controller.
      Should be <&hlic 11> for machine external interrupt.

interrupt-cells:
  - irq
  - priority
```

## dts/bindings/serial/esl-epfl,x-heep-uart.yaml
```yaml
# author: rbatal (rodrigo.batal@gmail.com)

description: >
  X-HEEP UART Controller (OpenTitan-based).
  Note: Register layout differs from the Zephyr libraries (lowrisc,opentitan-uart), different register layout.

compatible: "esl-epfl,x-heep-uart"

include: [uart-controller.yaml]

properties:
  reg:
    required: true
```

## dts/bindings/timer/esl-epfl,x-heep-rv-timer-ao.yaml
```yaml
# author: rbatal (rodrigo.batal@gmail.com)

description: |
  X-HEEP Always-On machine timer (lowRISC rv_timer IP, hart 0).

  Acts as the RISC-V machine timer: mtime and mtimecmp drive the MTIP
  (hart interrupt 7) used by Zephyr's riscv_machine_timer driver for the
  system tick. CTRL and CFG0 must be initialized before mtime starts
  counting. Zephyr's riscv_machine_timer driver does not do this, it is
  handled by soc_early_init (PRE_KERNEL_1) in soc.c.

  The "riscv,machine-timer" fallback compatible in the DTS node is required
  so that Zephyr's riscv_machine_timer driver binds via DT_INST.

  Register map (from base, confirmed against rv_timer_regs.h):
    0x000  CTRL          (ACTIVE_0 = bit 0: start/stop hart 0 counter)
    0x100  CFG0          (prescale[11:0], step[23:16])
    0x104  TIMER_V_LO    (mtime lower 32 bits, auto-incremented by HW)
    0x108  TIMER_V_HI    (mtime upper 32 bits)
    0x10C  COMPARE_LO    (mtimecmp lower 32 bits)
    0x110  COMPARE_HI    (mtimecmp upper 32 bits)
    0x114  INTR_ENABLE   (bit 0: IE_0)
    0x118  INTR_STATE    (bit 0: IS_0, write-1-to-clear)
    0x11C  INTR_TEST     (bit 0: T_0, write-only)

compatible: "esl-epfl,x-heep-rv-timer-ao"

include: [base.yaml]

properties:
  reg:
    required: true

  reg-names:
    required: true
    description: |
      Must be "ctrl", "cfg0", "mtime", "mtimecmp" in that order.

  clock-frequency:
    type: int
    required: true
    description: |
      Input clock frequency in Hz (100000000 for X-HEEP at 100 MHz).
      Determines the CFG0 prescale/step values needed so that mtime
      increments at the desired rate. With prescale=0 and step=1,
      mtime ticks once per clock cycle.

  interrupts-extended:
    required: true
    description: |
      Connection to the CPU hart interrupt controller.
      Must be <&hlic 7> (machine timer interrupt, MTIP).
```

## dts/bindings/timer/esl-epfl,x-heep-rv-timer.yaml
```yaml
# author: rbatal (rodrigo.batal@gmail.com)

description: |
  X-HEEP user-domain general-purpose timer (lowRISC rv_timer IP, hart 0).

  Same IP block as rv_timer_ao but located in the optional user peripheral
  domain (0x30040000). Unlike rv_timer_ao, this timer's interrupt is routed
  through FIC (Fast Interrupt Controller), not the PLIC.

  Exposed to Zephyr as a counter device via the Zephyr counter API.
  CTRL.ACTIVE_0 and CFG0.step must be written before the counter starts
  ticking (the driver does this in its init routine).

  Register map (from base, confirmed against rv_timer_regs.h):
    0x000  CTRL          (ACTIVE_0 = bit 0: start/stop hart 0 counter)
    0x100  CFG0          (prescale[11:0], step[23:16])
    0x104  TIMER_V_LO    (counter lower 32 bits, auto-incremented by HW)
    0x108  TIMER_V_HI    (counter upper 32 bits)
    0x10C  COMPARE_LO    (compare lower 32 bits)
    0x110  COMPARE_HI    (compare upper 32 bits)
    0x114  INTR_ENABLE   (bit 0: IE_0)
    0x118  INTR_STATE    (bit 0: IS_0, write-1-to-clear)
    0x11C  INTR_TEST     (bit 0: T_0, write-only)

compatible: "esl-epfl,x-heep-rv-timer"

include: [base.yaml]

properties:
  reg:
    required: true

  clock-frequency:
    type: int
    required: true
    description: |
      Input clock frequency in Hz (100000000 for X-HEEP at 100 MHz).
      With prescale=0 and step=1, the counter increments at the clock rate.
```

## soc/x_heep/Kconfig
```kconfig
# 
# X-HEEP SoC Family Kconfig
#

config SOC_FAMILY_X_HEEP
	bool

config SOC_FAMILY
	default "x_heep" if SOC_FAMILY_X_HEEP

rsource "Kconfig.soc"

if SOC_X_HEEP
rsource "Kconfig.defconfig"
endif
```

## soc/x_heep/Kconfig.defconfig
```kconfig
#
# X-HEEP SoC Kconfig defaults
#

if SOC_X_HEEP

# ============================================================
# Clock Configuration
# ============================================================
config SYS_CLOCK_HW_CYCLES_PER_SEC
  default 100000000

# ============================================================
# Interrupt Configuration
# ============================================================

# CRITICAL: Suppress Zephyr's built-in SiFive PLIC driver.
# The upstream intc_plic.c hardcodes the standard PLIC register offsets
# which do NOT match the X-HEEP OpenTitan rv_plic compact layout.
# Our custom driver (XHEEP_PLIC) provides the riscv_plic_* symbols.
config PLIC
  default n

# SW ISR table needs slots for:
#   - L1: 32 slots (standard RISC-V 0-11 + custom fast IRQs at mcause 16-31)
#   - L2: 64 PLIC sources (start at index 32, to avoid no overlap with FIC IRQ slots)
# Total = 32 + 64 = 96.
config NUM_IRQS
  default 96 if XHEEP_PLIC
  default 64

# Max sources per 2nd-level aggregator.
config MAX_IRQ_PER_AGGREGATOR
  default 64 if XHEEP_PLIC

# L2 ISR table starts after the 32 L1 entries.
config 2ND_LVL_ISR_TBL_OFFSET
  default 32 if XHEEP_PLIC

# L1 IRQ line the PLIC is connected to (Machine External Interrupt = 11).
config 2ND_LVL_INTR_00_OFFSET
  default 11 if XHEEP_PLIC

config GEN_ISR_TABLES
  default y

config GEN_IRQ_VECTOR_TABLE
  default n

config GEN_SW_ISR_TABLE
  default y

# ============================================================
# Stack Configuration
# ============================================================
config MAIN_STACK_SIZE
  default 2048

config ISR_STACK_SIZE
  default 2048

config IDLE_STACK_SIZE
  default 512

# ============================================================
# Memory Configuration
# ============================================================
config XIP
  default n

# ============================================================
# Timer
# ============================================================
config RISCV_MACHINE_TIMER
  default y

endif # SOC_X_HEEP
```

## soc/x_heep/Kconfig.soc
```kconfig
#
# X-HEEP SoC Kconfig.soc
#

config SOC_SERIES_X_HEEP
  bool
  select SOC_FAMILY_X_HEEP
  help
    X-HEEP RISC-V SoC series

config SOC_X_HEEP
  bool
  select SOC_SERIES_X_HEEP
  select RISCV
  select RISCV_ISA_RV32I
  select RISCV_ISA_EXT_ZICSR
  select RISCV_PRIVILEGED
  select RISCV_HAS_PLIC
  # Selected RISCV_HAS_PLIC so that Zephyr's arch layer calls the
  # riscv_plic_* API for multi-level interrupt management.
  # The UPSTREAM intc_plic.c driver (CONFIG_PLIC) is suppressed in
  # Kconfig.defconfig, our custom XHEEP_PLIC driver provides the
  # riscv_plic_* symbols with the correct register offsets.
  help
    X-HEEP platform SoC. Targets the common RV32I subset
    (supported by all X-HEEP cores).

config SOC
  default "x_heep" if SOC_X_HEEP
  
```
